ENTRY(usb_selector)
SECTIONS { . = 0x34200000; .selector_entry : { KEEP(*(.selector_entry)) } ASSERT(SIZEOF(.selector_entry)==4,"selector veneer") .controls_entry 0x34200100 : { KEEP(*(.controls_entry)) } ASSERT(SIZEOF(.controls_entry)==4,"controls veneer") .text : { KEEP(*(.text.entry)) KEEP(*(.text.hook)) *(.text*) *(.rodata*) } .data : { *(.data*) } . = ALIGN(4); __bss_start__ = .; .bss (NOLOAD) : { *(.bss*) *(COMMON) } . = ALIGN(4); __bss_end__ = .; /DISCARD/ : { *(.ARM.exidx*) *(.ARM.extab*) *(.comment*) *(.note*) } ASSERT(. < 0x34210000,"overflow") }